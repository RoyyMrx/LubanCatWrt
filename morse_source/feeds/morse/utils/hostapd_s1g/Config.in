## morse_source/feeds/morse/utils/hostapd_s1g/Config.in
```kconfig
config MORSE_HOSTAPD_S1G_EAP
	bool
    depends on PACKAGE_hostapd_s1g
	default n
    help
        Enable Extensible Authentication Protocol (EAP) server into hostapd_s1g

config MORSE_HOSTAPD_S1G_ACS
	bool
    depends on PACKAGE_hostapd_s1g
	default n
    help 
        This will allow hostapd to pick the channel automatically when channel is set
        to "acs_survey" or "0". Eventually, other ACS algorithms can be added in
        similar way.
```

## morse_source/feeds/morse/utils/wpa_supplicant_s1g/Config.in
```kconfig
config MORSE_WPA_SUPPLICANT_S1G_MESH_NETWORKING
	bool
    depends on PACKAGE_wpa_supplicant_s1g
	default n
    help
        Enable Mesh Networking (IEEE 802.11s)
```

## morse_source/feeds/prpl/prplmesh/Config.in
```kconfig
if PACKAGE_prplmesh

config PRPLMESH_NBAPI
    bool
    default y
    prompt "Enable use of NBAPI (Ambiorix)."
    help
      Enable the NBAPI (Ambiorix) for the runtime data model handling.

config PRPLMESH_UNIT_TESTS
    bool
    default n
    prompt "Build unit tests"
    help
      Build and install the unit tests.

config PRPLMESH_DEBUG
    bool
    default n
    prompt "Enable debug build option"
    help
      Enable verbose build ouput, remove compiler optimisations and use -g
      when compiling.

config PRPLMESH_STATIC_LIBRARIES
    bool
    default n
    prompt "Enable static libraries (.a) for common components."
    help
      By default, PrplMesh components stored use dynamic libabires (.so)
      stored in /usr/lib, which reduces storage requirements significantly,
      but makes debug harder (especially when frequently updating the binaries).
endif
```
